## conf/machine/enibox.conf
```bitbake
#
# This is config file for HDBox EniBox
#

require conf/machine/include/vg5000.inc

RCNAME = "hdbox"

DISPLAY_BRAND = "hdbox"
```

## conf/machine/evoslimse.conf
```bitbake
#
# This is config file for Evo Slim SE
#

require conf/machine/include/yh7362.inc

IMAGEDIR = "slim"

RCNAME = "evo8"
RCIDNUM = "1"

MACHINE_FEATURES += "eDBoxLCD"

DISPLAY_BRAND = "EVO"
DISPLAY_MODEL = "SLIM SE"
```

## conf/machine/evoslimt2c.conf
```bitbake
#
# This is config file for Evo Slim T2C
#

MTD_ROOTFS = "mtd0"

IMAGEDIR = "slimt2c"

MACHINE_ESSENTIAL_EXTRA_RDEPENDS += "\
	tripledot-dvb-modules-yh62tc \
	"

PREFERRED_PROVIDER_virtual/kernel = "linux-tripledot-yh62tc"
PREFERRED_VERSION_linux-tripledot-yh62tc = "${KERNELVERSION}"

SOC_FAMILY = "bcm7362"

MKUBIFS_ARGS = "-m 2048 -e 126976 -c 4096"
UBINIZE_ARGS = "-m 2048 -p 128KiB -s 2048"

MACHINE_FEATURES += "dvb-c"

require conf/machine/include/tripledot-oem.inc

MACHINE_EXTRA_RRECOMMENDS += "\
	tripledot-cfe \
	"
```

## conf/machine/include/yh7362.inc
```bitbake
require conf/machine/include/tripledot-oem.inc

MTD_ROOTFS = "mtd0"

MACHINE_ESSENTIAL_EXTRA_RDEPENDS += "\
    tripledot-dvb-modules-yh7362 \
    "

PREFERRED_PROVIDER_virtual/kernel = "linux-tripledot-yh7362"

SOC_FAMILY = "bcm7362"

MKUBIFS_ARGS = "-m 2048 -e 126976 -c 4096"
UBINIZE_ARGS = "-m 2048 -p 128KiB -s 2048"

MACHINE_EXTRA_RRECOMMENDS += "\
    tripledot-cfe \
    "

STB_PLATFORM = "yh7362"
```

## conf/machine/sf108.conf
```bitbake
#
# This is config file for Octagon SF108 E2HD
#

require conf/machine/include/vg5000.inc

RCNAME = "sf108"

DISPLAY_BRAND = "Octagon"
DISPLAY_MODEL = "SF108 E2HD"
```

## conf/machine/sf98.conf
```bitbake
#
# This is config file for Octagon SF98
#

require conf/machine/include/yh7362.inc

RCNAME = "sf98"
RCIDNUM = "1"

MACHINE_FEATURES += "eDBoxLCD"

DISPLAY_BRAND = "Octagon"
```

## conf/machine/tyrant.conf
```bitbake
#
# This is config file for Tripledot Tyrant
#

MTD_ROOTFS = "mtd8"

MACHINE_ESSENTIAL_EXTRA_RDEPENDS += "\
    tripledot-dvb-modules-vg1000 \
    "

PREFERRED_PROVIDER_virtual/kernel = "linux-tripledot-vg1000"

SOC_FAMILY = "bcm7356"

UBI_VOLNAME = "rootfs"
MKUBIFS_ARGS = "-m 2048 -e 126976 -c 4096"
UBINIZE_ARGS = "-m 2048 -p 128KiB -s 2048"

MACHINE_FEATURES += "dvb-c ci textlcd AV_JACK"

require conf/machine/include/tripledot-oem.inc
```

## conf/machine/xcombo.conf
```bitbake
#
# This is config file for Evo EnfinityX Combo Plus
#

MTD_ROOTFS = "mtd8"

IMAGEDIR = "xcombo"

MACHINE_ESSENTIAL_EXTRA_RDEPENDS += "\
    tripledot-dvb-modules-vg2000 \
    "

PREFERRED_PROVIDER_virtual/kernel = "linux-tripledot-vg2000"

SOC_FAMILY = "bcm7362"

UBI_VOLNAME = "rootfs"
MKUBIFS_ARGS = "-m 2048 -e 126976 -c 4096"
UBINIZE_ARGS = "-m 2048 -p 128KiB -s 2048"

MACHINE_FEATURES += "ci 7segment textlcd"

require conf/machine/include/tripledot-oem.inc
```
